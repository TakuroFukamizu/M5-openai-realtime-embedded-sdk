## sdkconfig.defaults.atoms3_echobase
```kconfig
## For AtomS3 + Atomic Echo Base
CONFIG_MEDIA_ATOMIC_ECHO_BASE=y
CONFIG_MEDIA_I2S_RX_TX_SHARED=y
CONFIG_MEDIA_I2S_RX_MCLK_PIN=0
CONFIG_MEDIA_I2S_RX_BCLK_PIN=0
CONFIG_MEDIA_I2S_RX_LRCLK_PIN=0
CONFIG_MEDIA_I2S_RX_DATA_PIN=7
CONFIG_MEDIA_I2S_TX_MCLK_PIN=-1
CONFIG_MEDIA_I2S_TX_BCLK_PIN=8
CONFIG_MEDIA_I2S_TX_LRCLK_PIN=6
CONFIG_MEDIA_I2S_TX_DATA_PIN=5
```

## src/Kconfig.projbuild
```kconfig
menu "Embedded SDK Configuration"
    config WIFI_SSID
        string "WiFi SSID"
        depends on !USE_WIFI_PROVISIONING_SOFTAP
        help
            The SSID of the SoftAP for WiFi
    config WIFI_PASSWORD
        string "WiFi Password"
        depends on !USE_WIFI_PROVISIONING_SOFTAP
        help
            The password of the SoftAP for WiFi
    config OPENAI_API_KEY
        string "OpenAI API Key"
        depends on !USE_WIFI_PROVISIONING_SOFTAP
        help
            The OpenAI API key
    config OPENAI_REALTIMEAPI
        string "OpenAI Realtime API"
        default "https://api.openai.com/v1/realtime?model=gpt-4o-mini-realtime-preview-2024-12-17"
        help
            The OpenAI Realtime API URI
endmenu
```
